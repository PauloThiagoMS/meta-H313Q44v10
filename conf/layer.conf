## conf/layer.conf
```bitbake
# We have a conf and classes directory, add to BBPATH
BBPATH .= ":${LAYERDIR}"

# We have recipes-* directories, add to BBFILES
BBFILES += "${LAYERDIR}/recipes-*/*/*.bb \
            ${LAYERDIR}/recipes-*/*/*.bbappend"

BBFILE_COLLECTIONS += "meta-H313Q44v10"
BBFILE_PATTERN_meta-H313Q44v10 = "^${LAYERDIR}/"
BBFILE_PRIORITY_meta-H313Q44v10 = "6"

LAYERDEPENDS_meta-H313Q44v10 = "core"
LAYERSERIES_COMPAT_meta-H313Q44v10 = "kirkstone"
```
